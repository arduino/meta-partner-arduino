/**
 * Portenta-X8 dtb overlay file
 * Arduino 2021
 * Enable a pwm controlled fan with tacho on an irq gpio.
 * Both I/Os are operated through the portenta-x8 external
 * microcontroller (stm32h7).
 */

/dts-v1/;
/plugin/;

#include "imx8mm-pinfunc.h"
#include <dt-bindings/gpio/gpio.h>
#include <dt-bindings/interrupt-controller/arm-gic.h>

/ {
	compatible = "fsl,imx8mm-evk", "fsl,imx8mm";

	fragment@0 {
		target-path = "/";
		__overlay__ {
			fan0: pwm-fan {
				compatible = "pwm-fan";
				pwms = <&x8h7_pwm 0 40000 0>;
				interrupt-parent = <&x8h7_gpio>;
				interrupts = <0 IRQ_TYPE_EDGE_FALLING>;
				pulses-per-revolution = <2>;
				status = "okay";
			};
		};
	};
};