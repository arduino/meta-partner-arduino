/**
 * Portenta-X8 dtb overlay file
 * Arduino 2021
 */

/dts-v1/;
/plugin/;

/ {
	compatible = "fsl,imx8mm-evk", "fsl,imx8mm";

	fragment@0 {
		target = <&ecspi1>;
		__overlay__ {
			spidev_cb: spidev@0 {
				compatible = "rohm,dh2228fv";
				spi-max-frequency = <1000000>;
				reg = <0>;
			};
		};
	};
};
