/**
 * Portenta-M8 dtb overlay file
 * Arduino 2021
 */

/dts-v1/;
/plugin/;

/ {
	compatible = "fsl,imx8mm-evk", "fsl,imx8mm";

	fragment@0 {
		target = <&ecspi2>;
		__overlay__ {
			spidev_cb: spidev@1 {
				#address-cells = <1>;
				#size-cells = <1>;
				compatible = "spidev";
				spi-max-frequency = <20000000>;
				reg = <1>;
			};
		};
	};
};
