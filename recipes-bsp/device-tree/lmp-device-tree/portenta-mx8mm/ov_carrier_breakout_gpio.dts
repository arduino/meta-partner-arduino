/**
 * Portenta-M8 dtb overlay file
 * Arduino 2021
 */

/dts-v1/;
/plugin/;

#include "imx8mm-pinfunc.h"

/ {
	compatible = "fsl,imx8mm-evk", "fsl,imx8mm";

	fragment@0 {
		target = <&iomuxc>;
		__overlay__ {
			imx8mm {
				pinctrl_hog: hoggrp {
					fsl,pins = <
						MX8MM_IOMUXC_GPIO1_IO07_GPIO1_IO7     0xC0000041
						MX8MM_IOMUXC_GPIO1_IO08_GPIO1_IO8     0xC0000041
						MX8MM_IOMUXC_GPIO1_IO09_GPIO1_IO9     0xC0000041
						MX8MM_IOMUXC_GPIO1_IO10_GPIO1_IO10    0xC0000041
						MX8MM_IOMUXC_GPIO1_IO11_GPIO1_IO11    0xC0000041
						MX8MM_IOMUXC_SAI5_RXFS_GPIO3_IO19     0xC0000041
						MX8MM_IOMUXC_SAI5_RXC_GPIO3_IO20      0xC0000041
					>;
				};
			};
		};
	};
};
