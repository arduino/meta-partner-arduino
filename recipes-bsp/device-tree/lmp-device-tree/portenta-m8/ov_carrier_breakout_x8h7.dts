/**
 * Portenta-M8 dtb overlay file
 * Arduino 2021
 */

/dts-v1/;
/plugin/;

#include <dt-bindings/gpio/gpio.h>
#include <dt-bindings/interrupt-controller/arm-gic.h>
#include <dt-bindings/clock/imx8mm-clock.h>
#include "imx8mm-pinfunc.h"

/ {
	compatible = "fsl,imx8mm-evk", "fsl,imx8mm";

	fragment@0 {
		target = <&ecspi2>;
		__overlay__ {
			x8h7: x8h7@0 {
				#address-cells = <1>;
				#size-cells = <1>;
				compatible = "portenta,x8h7";
				reg = <0>;
				pinctrl-0 = <&pinctrl_irq_x8h7>;
				interrupt-parent = <&gpio1>;
				interrupts = <9 GPIO_ACTIVE_LOW>;
				spi-max-frequency = <1000000>;
			};
		};
	};
};
