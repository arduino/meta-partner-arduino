## conf/layer.conf
```bitbake
# We might have a conf and classes directory, append to BBPATH
BBPATH .= ":${LAYERDIR}"

# We have a recipes directory, add to BBFILES
BBFILES += "${LAYERDIR}/recipes*/*/*.bb ${LAYERDIR}/recipes*/*/*.bbappend"

BBFILE_COLLECTIONS += "meta-partner-arduino"
BBFILE_PATTERN_meta-partner-arduino := "^${LAYERDIR}/"
BBFILE_PRIORITY_meta-partner-arduino = "9"

LAYERDEPENDS_meta-partner-arduino = "meta-lmp-base"
LAYERSERIES_COMPAT_meta-partner-arduino = "dunfell gatesgarth hardknott kirkstone"
```

## conf/machine/include/lmp-partner-custom.inc
```bitbake
# LMP partner specific customizations (either replace or extend options as defined by meta-lmp)

PACKAGECONFIG:append:pn-networkmanager:portenta-mx8mm = " modemmanager"

# drop idle timeout in weston
PACKAGECONFIG:append:pn-weston-init:portenta-mx8mm = " no-idle-timeout"

## Portenta i.MX8MMini with EBBR / SystemReady
UBOOT_SIGN_ENABLE:sota:portenta-mx8mm-ebbr = ""
KERNEL_IMAGETYPE:sota:portenta-mx8mm-ebbr ?= "Image"
KERNEL_CLASSES:sota:portenta-mx8mm-ebbr ?= ""
EFI_PROVIDER:portenta-mx8mm-ebbr ?= "grub-efi"
OSTREE_BOOTLOADER:portenta-mx8mm-ebbr ?= "grub"
IMAGE_EFI_BOOT_FILES:sota:portenta-mx8mm-ebbr ?= "${@make_dtb_boot_files(d)}"
WKS_FILE:sota:portenta-mx8mm-ebbr ?= "efidisk-sota.wks.in"
```

## conf/machine/include/portenta-mx8mm.inc
```bitbake
MACHINEOVERRIDES =. "mx8:mx8m:mx8mm:imx8mm-lpddr4-evk:portenta-mx8mm:"

require conf/machine/include/imx-base.inc
require conf/machine/include/arm/armv8a/tune-cortexa53.inc

IMX_DEFAULT_BSP = "nxp"

MACHINE_FEATURES += " pci wifi bluetooth optee alsa"

KERNEL_DEVICETREE = ""
KERNEL_DEVICETREE:remove:portenta-mx8mm = " freescale/imx8mm-evkb.dtb"
PREFERRED_PROVIDER:virtual/dtb ?= "lmp-device-tree"

UBOOT_SUFFIX = "bin"

SPL_BINARY = "spl/u-boot-spl.bin"

ATF_PLATFORM = "imx8mm"
ATF_LOAD_ADDR = "0x920000"

# Set DDR FIRMWARE
DDR_FIRMWARE_NAME = "lpddr4_pmu_train_1d_imem.bin lpddr4_pmu_train_1d_dmem.bin lpddr4_pmu_train_2d_imem.bin lpddr4_pmu_train_2d_dmem.bin"

# Set imx-mkimage boot target
IMXBOOT_TARGETS = "${@bb.utils.contains('UBOOT_CONFIG', 'fspi', 'flash_evk_flexspi', 'flash_evk', d)}"
IMX_BOOT_SOC_TARGET = "iMX8MM"

BOOT_SPACE = "65536"

LOADADDR = ""
UBOOT_MAKE_TARGET = ""

IMX_BOOT_SEEK = "33"
# make sure we build the devicetree and add it to lmp-base builds
EXTRA_IMAGEDEPENDS:append = " virtual/dtb "

OPTEE_BIN_EXT = "8mm"

# Add additional firmware
MACHINE_FIRMWARE:append = " linux-firmware linux-firmware-cyw-fmac-fw linux-firmware-cyw-fmac-nvram linux-firmware-cyw-bt-patch"

# Add kernel-module recipe recommendations
MACHINE_EXTRA_RRECOMMENDS += " bq24195 cs42l52 anx7625"

# Portenta MX8MM has a Murata 1DX wifi/bt module which uses custom recipes
# linux-firmware-cyw-fmac-fw, linux-firmware-cyw-fmac-nvram and linux-firmware-cyw-bt-patch.
# Make sure we avoid default linux bcm43430 firmware
CORE_IMAGE_BASE_INSTALL:remove:portenta-mx8mm = " \
    linux-firmware-bcm43430 \
"

KERNEL_MODULE_AUTOLOAD:portenta-mx8mm:append = "anx7625 i2c-dev"
```

## conf/machine/portenta-m8-ebbr.conf
```bitbake
#@TYPE: Machine
#@NAME: Arduino Portenta i.MX8MM M8 with EBBR
#@SOC: i.MX8MM
#@DESCRIPTION: Machine configuration for Arduino Portenta i.MX8MMini M8
#              following the EBBR requirements (UEFI)

require conf/machine/portenta-m8.conf

KMACHINE = "portenta-m8"
MACHINE_FEATURES += "efi ebbr"
MACHINEOVERRIDES .= ":portenta-m8:portenta-mx8mm-ebbr"
```

## conf/machine/portenta-m8.conf
```bitbake
#@TYPE: Machine
#@NAME: Arduino Portenta-M8 i.MX8MM
#@SOC: i.MX8MM
#@DESCRIPTION: Machine configuration for Arduino Portenta-M8 (i.MX 8M Mini)
#@MAINTAINER: Massimiliano Agneni <massimiliano.agneni@iptronix.com>

require conf/machine/include/portenta-mx8mm.inc

# Set Serial console
SERIAL_CONSOLE = "115200;ttymxc1"

OSTREE_KERNEL_ARGS:portenta-m8 ?= "console=tty1 console=ttymxc1,115200 earlycon=ec_imx6q,0x30890000,115200 root=/dev/mmcblk2p2 rootfstype=ext4"

# U-Boot
UBOOT_MACHINE:portenta-m8 = "portenta-m8_config"
UBOOT_DTB_NAME = "portenta-m8.dtb"

# Kernel
KERNEL_DEFCONFIG = "portenta_m8_defconfig"

# Add DTB for lmp-base build
IMAGE_BOOT_FILES:append:lmp-base = " devicetree/arduino_portenta-m8.dtb;portenta-m8.dtb"
```

## conf/machine/portenta-x8-ebbr.conf
```bitbake
#@TYPE: Machine
#@NAME: Arduino Portenta i.MX8MM X8 with EBBR
#@SOC: i.MX8MM
#@DESCRIPTION: Machine configuration for Arduino Portenta i.MX8MMini X8
#              following the EBBR requirements (UEFI)

require conf/machine/portenta-x8.conf

KMACHINE = "portenta-x8"
MACHINE_FEATURES += "efi ebbr"
MACHINEOVERRIDES .= ":portenta-x8:portenta-mx8mm-ebbr"
```

## conf/machine/portenta-x8-preempt-rt.conf
```bitbake
#@TYPE: Machine
#@NAME: Arduino Portenta i.MX8MM X8 with Preempt-RT patch
#@SOC: i.MX8MM
#@DESCRIPTION: Machine configuration for Arduino Potenta-X8 (i.MX 8M Mini + STM32H7)
#@MAINTAINER: Massimo Pennazio <m.pennazio@arduino.cc>

require conf/machine/portenta-x8.conf

MACHINEOVERRIDES =. "portenta-mx8mm:portenta-x8:"
PREFERRED_PROVIDER_virtual/kernel:mx8mm-nxp-bsp ?= "linux-lmp-fslc-imx-rt"
```

## conf/machine/portenta-x8.conf
```bitbake
#@TYPE: Machine
#@NAME: Arduino Portenta-X8 i.MX8MM
#@SOC: i.MX8MM
#@DESCRIPTION: Machine configuration for Arduino Potenta-X8 (i.MX 8M Mini + STM32H7)
#@MAINTAINER: Massimiliano Agneni <massimiliano.agneni@iptronix.com>

require conf/machine/include/portenta-mx8mm.inc

# Set Serial console
SERIAL_CONSOLE = "115200;ttymxc2"

OSTREE_KERNEL_ARGS:portenta-x8 ?= "console=tty1 console=ttymxc2,115200 earlycon=ec_imx6q,0x30880000,115200 root=/dev/mmcblk2p2 rootfstype=ext4"

# U-Boot
UBOOT_MACHINE:portenta-x8 = "portenta-x8_config"
UBOOT_DTB_NAME = "portenta-x8.dtb"

# Kernel
KERNEL_DEFCONFIG = "portenta_x8_defconfig"

# Add DTB for lmp-base builds
IMAGE_BOOT_FILES:append:lmp-base = " devicetree/arduino_portenta-x8.dtb;portenta-x8.dtb"

# Add additional firmware
MACHINE_FIRMWARE:append = " linux-firmware-arduino-portenta-x8-stm32h7"

# Add x8h7 driver for communication with external cortex processor via spi
MACHINE_EXTRA_RRECOMMENDS += "x8h7"

# Add mipi-csi cmos sensors drivers
MACHINE_EXTRA_RRECOMMENDS += "ov5647-mipi imx219 imx477 imx708"

# Add mipi-dsi panels and touch screen controllers drivers
MACHINE_EXTRA_RRECOMMENDS += "panel-sitronix-st7701 panel-jadard-ek79202d atmel-mxt-ts"

# Add neural external pcie modules drivers
MACHINE_EXTRA_RRECOMMENDS += "google-gasket-driver akida-pcie-driver hailo-pcie-driver"

# Devel modules
MACHINE_EXTRA_RRECOMMENDS:append:lmp-base = " dtbocfg"

# Add se05x by default for production/secure builds
MACHINE_FEATURES:append:lmp = " se05x"
MACHINE_FEATURES:remove:lmp-base = " se05x"
MACHINE_FEATURES:remove:lmp-mfgtool = " se05x"
SE05X_OEFID = "0xA201"

# @TODO: current u-boot-fio breaks do_deploy without optee
#MACHINE_FEATURES:remove:lmp-base = " optee"
```
